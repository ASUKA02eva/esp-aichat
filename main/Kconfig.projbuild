## main/Kconfig.projbuild
```kconfig
menu "ESP-AI 智能语音助手配置"

    config APP_LLM_ENABLE
        bool "启用大模型对话（需要 WiFi 与电脑上的 server.py）"
        default y
        help
            打开：唤醒 → 先匹配本地命令词（开灯/关灯/拜拜）→ 没匹配上就把
                  音频通过 WebSocket 发给电脑端大模型，进行多轮对话。
            关闭：纯离线模式，只用本地唤醒词 + 命令词，不连接网络。

    config APP_WIFI_SSID
        string "WiFi 名称 (SSID)"
        default ""
        help
            留空表示不联网（等价于离线模式）。

    config APP_WIFI_PASSWORD
        string "WiFi 密码"
        default ""

    config APP_WS_URI
        string "大模型服务端地址 (WebSocket)"
        default "ws://192.168.1.100:8888"
        help
            电脑上运行 server/server.py 后打印出来的地址，注意填电脑的局域网 IP。

    config APP_LED_GPIO
        int "LED 指示灯 GPIO"
        range 0 48
        default 21

    config APP_ENABLE_BUTTON
        bool "启用按键唤醒（等同于说唤醒词）"
        default y

    config APP_BUTTON_GPIO
        int "按键 GPIO"
        range 0 48
        default 41

    config APP_ENABLE_SERVO
        bool "启用舵机控制（开关灯时转一下作为动作反馈）"
        default y

    config APP_SERVO_GPIO
        int "舵机 PWM 信号 GPIO"
        range 0 48
        default 18

    config APP_IDLE_TIMEOUT_MS
        int "等待说话 / 等待命令的超时时间 (毫秒)"
        default 10000

    config APP_CMD_CONFIRM_ROTATE_DEG
        int "开关灯时舵机转动角度 (度)"
        range 0 180
        default 45

    config APP_MAX_RECORDING_SEC
        int "单次最长录音时长 (秒)"
        range 1 30
        default 10

    config APP_VAD_SILENCE_MS
        int "VAD 判定“说完了”所需的静音时长 (毫秒)"
        range 100 3000
        default 600

endmenu
```

## sdkconfig.defaults
```kconfig
# ============================================================================
# 默认配置（所有目标通用）
#   目标相关配置见 sdkconfig.defaults.esp32s3
#   应用级配置可在 idf.py menuconfig → ESP-AI 智能语音助手配置 中修改
# ============================================================================

# ---- Flash / 分区表 ----
# 语音模型很大，必须使用自定义分区表（见根目录 partitions.csv）
CONFIG_ESPTOOLPY_FLASHMODE_QIO=y
CONFIG_PARTITION_TABLE_CUSTOM=y
CONFIG_PARTITION_TABLE_CUSTOM_FILENAME="partitions.csv"
CONFIG_PARTITION_TABLE_FILENAME="partitions.csv"
CONFIG_PARTITION_TABLE_MD5=y

# ---- ESP-SR 语音模型 ----
# 唤醒词："你好小智"；命令词：MultiNet7 中文
CONFIG_SR_WN_WN9_NIHAOXIAOZHI_TTS=y
CONFIG_SR_MN_CN_MULTINET7_QUANT=y
CONFIG_SR_MN_EN_NONE=y
# 模型放 Flash（启动快，省内存）
CONFIG_MODEL_IN_FLASH=y

# ---- 应用默认参数（可 menuconfig 修改）----
# WiFi 名称留空 => 自动进入离线模式（仅本地唤醒词 + 命令词）
CONFIG_APP_LLM_ENABLE=y
CONFIG_APP_WIFI_SSID=""
CONFIG_APP_WIFI_PASSWORD=""
CONFIG_APP_WS_URI="ws://192.168.1.100:8888"

# 外设
CONFIG_APP_LED_GPIO=21
CONFIG_APP_ENABLE_BUTTON=y
CONFIG_APP_BUTTON_GPIO=41
CONFIG_APP_ENABLE_SERVO=y
CONFIG_APP_SERVO_GPIO=18

# 行为
CONFIG_APP_IDLE_TIMEOUT_MS=10000
CONFIG_APP_CMD_CONFIRM_ROTATE_DEG=45
CONFIG_APP_MAX_RECORDING_SEC=10
CONFIG_APP_VAD_SILENCE_MS=600
```

## sdkconfig.defaults.esp32s3
```kconfig
# ============================================================================
# ESP32-S3 专用默认配置（idf.py set-target esp32s3 时自动应用）
#   硬件：ESP32-S3-DevKitC-1（16MB Flash + 8MB OCT PSRAM）
# ============================================================================

CONFIG_IDF_TARGET="esp32s3"

# ---- Flash：16MB，QIO ----
CONFIG_ESPTOOLPY_FLASHMODE_QIO=y
CONFIG_ESPTOOLPY_FLASHSIZE_16MB=y

# ---- 分区表：自定义（app 3MB + 语音模型 6MB）----
CONFIG_PARTITION_TABLE_CUSTOM=y
CONFIG_PARTITION_TABLE_CUSTOM_FILENAME="partitions.csv"
CONFIG_PARTITION_TABLE_FILENAME="partitions.csv"
CONFIG_PARTITION_TABLE_OFFSET=0x8000
CONFIG_PARTITION_TABLE_MD5=y

# ---- ESP-SR 音频前端与模型 ----
CONFIG_MODEL_IN_FLASH=y
CONFIG_AFE_INTERFACE_V1=y
CONFIG_SR_NSN_WEBRTC=y
CONFIG_SR_VADN_VADNET1_MEDIUM=y
CONFIG_SR_WN_WN9_NIHAOXIAOZHI_TTS=y
CONFIG_SR_MN_CN_MULTINET7_QUANT=y
CONFIG_SR_MN_EN_NONE=y

# ---- CPU 频率与缓存（保证音频处理实时性）----
CONFIG_ESP_DEFAULT_CPU_FREQ_MHZ_240=y
CONFIG_ESP32S3_INSTRUCTION_CACHE_32KB=y
CONFIG_ESP32S3_INSTRUCTION_CACHE_8WAYS=y
CONFIG_ESP32S3_INSTRUCTION_CACHE_LINE_32B=y
CONFIG_ESP32S3_DATA_CACHE_64KB=y
CONFIG_ESP32S3_DATA_CACHE_8WAYS=y
CONFIG_ESP32S3_DATA_CACHE_LINE_64B=y

# ---- 8MB 八线 PSRAM（语音模型 + 网络缓冲区都放这里）----
CONFIG_SPIRAM=y
CONFIG_SPIRAM_MODE_OCT=y
CONFIG_SPIRAM_TYPE_AUTO=y
CONFIG_SPIRAM_SPEED_80M=y
CONFIG_SPIRAM_BOOT_INIT=y
CONFIG_SPIRAM_USE_MALLOC=y
CONFIG_SPIRAM_MALLOC_ALWAYSINTERNAL=4096
CONFIG_SPIRAM_MALLOC_RESERVE_INTERNAL=49152
CONFIG_SPIRAM_MEMTEST=n

# ---- 网络 / TLS 缓冲区使用外部内存，省内部 RAM ----
CONFIG_MBEDTLS_EXTERNAL_MEM_ALLOC=y

# ---- 任务栈与 FreeRTOS ----
CONFIG_ESP_SYSTEM_EVENT_TASK_STACK_SIZE=4096
CONFIG_ESP_MAIN_TASK_STACK_SIZE=10240
CONFIG_ESP_MAIN_TASK_AFFINITY_CPU0=y
CONFIG_FREERTOS_HZ=1000
CONFIG_FREERTOS_CHECK_STACKOVERFLOW_CANARY=y

# ---- 编译优化：优先体积（Flash 里还要放语音模型）----
CONFIG_COMPILER_OPTIMIZATION_SIZE=y
CONFIG_COMPILER_OPTIMIZATION_ASSERTIONS_ENABLE=y
CONFIG_COMPILER_ORPHAN_SECTIONS_PLACE=y

# ---- 关键中断放 IRAM，避免音频丢帧 ----
CONFIG_PERIPH_CTRL_FUNC_IN_IRAM=y
CONFIG_GDMA_CTRL_FUNC_IN_IRAM=y
CONFIG_SPI_MASTER_ISR_IN_IRAM=y
CONFIG_SPI_SLAVE_ISR_IN_IRAM=y

# ---- 日志 ----
CONFIG_LOG_DEFAULT_LEVEL_INFO=y
CONFIG_LOG_MAXIMUM_EQUALS_DEFAULT=y

# ---- 系统异常处理 ----
CONFIG_ESP_SYSTEM_PANIC_PRINT_REBOOT=y
```
